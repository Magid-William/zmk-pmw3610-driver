## Kconfig
```kconfig
# Sensor data simulator
#
# Copyright (c) 2019 Nordic Semiconductor
#
# SPDX-License-Identifier: LicenseRef-Nordic-5-Clause
#

menuconfig TRACKPOINT_I2C
  bool "I2C trackpoint (Pro Mini I2C slave)"
  select I2C
  depends on INPUT
  depends on DT_HAS_PROMINI_TRACKPOINT_I2C_ENABLED
  help
      Enable I2C trackpoint driver for Pro Mini I2C slave handshake.

if TRACKPOINT_I2C

module = TRACKPOINT_I2C
module-str = TRACKPOINT_I2C
source "${ZEPHYR_BASE}/subsys/logging/Kconfig.template.log_config"

endif #TRACKPOINT_I2C
```

## dts/bindings/promini,trackpoint-i2c.yml
```yaml
description: I2C trackpoint slave (Pro Mini emulator)

compatible: "promini,trackpoint-i2c"

include: i2c-device.yaml

properties:
  irq-gpios:
    type: phandle-array
  reset-gpios:
    type: phandle-array
  swap-xy:
    type: boolean
  invert-x:
    type: boolean
  invert-y:
    type: boolean
  speed-scale:
    type: int
    default: 255
    description: Speed scaling factor (1-255, 255 = 100%, 204 = 80%, 128 = 50%)
  curve-rate:
    type: int
    default: 0
    description: PowerCurve rate, Q8.8 fixed point (18 = 0.07). f(v) = start + (rate*v)^exp.
  curve-exponent:
    type: int
    default: 256
    description: PowerCurve exponent, Q8.8 fixed point (256 = 1.0).
  curve-start:
    type: int
    default: 256
    description: PowerCurve output offset (gain at v=0), Q8.8 fixed point (77 = 0.30).
```
